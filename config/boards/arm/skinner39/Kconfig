## config/boards/arm/skinner39/Kconfig
```kconfig
config BOARD_ENABLE_DCDC
    bool "Enable DCDC mode"
    select SOC_DCDC_NRF52X
    default y

config PMW3610_SCROLL_TICK
    int "Scroll tick interval for PMW3610 sensor"
    default 10
    help
      Interval (in ms) for processing scroll input from the PMW3610 sensor.

config PMW3610_INVERT_SCROLL_Y
    bool "Invert Y-axis scrolling for PMW3610"
    default n
    help
      Inverts the Y-axis of scroll events reported by the PMW3610 sensor.
```

## config/west.yml
```yaml
manifest:
  remotes:
    - name: zmk
      url-base: https://github.com/zmkfirmware
    - name: badjeff
      url-base: https://github.com/badjeff
      name: goldgon
      url-base: https://github.com/goldgon
  projects:
    - name: zmk
      remote: zmk
      revision: main
      import: app/west.yml
    - name: zmk-pmw3610-driver
      remote: goldgon
      revision: main
    - name: zmk-split-peripheral-input-relay
      remote: badjeff
      revision: main
    - name: zmk-input-behavior-listener
      remote: badjeff
      revision: main
    - name: zmk-lpm009m360a-driver
      remote: goldgon
      revision: master
  self:
    path: config
```
